## software/firmware/node-one/Kconfig.projbuild
```kconfig
# Node One Kconfig.projbuild
# Menuconfig options for ESP-IDF

menu "Node One Hardware Configuration"

    menu "Display Configuration"
        config LV_COLOR_16_SWAP
            bool "Swap RGB565 byte order"
            default y
            help
                Swap the byte order for RGB565 color format to match
                the Waveshare ESP32-S3-Touch-LCD-3.5B display.

        config DISPLAY_SPI_CLOCK
            int "Display SPI clock frequency (Hz)"
            default 40000000
            range 1000000 80000000
            help
                SPI clock for QSPI display. Default 40MHz provides
                stable operation with fallback to 20MHz if needed.

        config QSPI_DMA_ALIGNMENT
            bool "Enable DMA alignment fixes"
            default y
            help
                Fixes tearing and static issues on QSPI bus by
                improving internal memory allocation.
    endmenu

    menu "Audio Configuration (ES8311)"
        config ES8311_MCLK_LESS
            bool "Enable MCLK-less mode"
            default y
            help
                Derive Master Clock from Bit Clock. This frees GPIO 44
                and prevents hardware conflict with UART console.

        config I2S_DMA_BUFFER_SIZE
            int "I2S DMA buffer size"
            default 512
            help
                Buffer size for I2S audio. Increase to 512+ to prevent
                "pop" sound from being cut off during amplifier wake-up.

        config I2S_AEC_ENABLED
            bool "Enable Acoustic Echo Cancellation"
            default y
            help
                Software-level AEC for onboard microphone (GPIO 40)
                to reduce feedback when speaker is at high volume.
    endmenu

    menu "Touch Controller (AXS15231B)"
        config TOUCH_SWAP_X_Y
            bool "Swap X/Y coordinates"
            default y
            help
                Hardware-level coordinate mapping fix for 3.5B board.

        config TOUCH_INVERT_COORDS
            bool "Invert touch coordinates"
            default y
            help
                Fix inverted or offset touch points on Waveshare display.

        config TOUCH_GESTURE_THRESHOLD
            int "Swipe gesture threshold (pixels)"
            default 20
            help
                Prevents accidental "Emergency Override" triggers from
                normal swipe gestures.
    endmenu

    menu "Memory & PSRAM"
        config PSRAM_ALIGNMENT_64B
            bool "Enable 64-byte cache line alignment"
            default y
            help
                Matches 8MB Octal PSRAM alignment requirements.
                Prevents StoreProhibited crashes.

        config DMA_BUFFERS_INTERNAL
            bool "Keep DMA buffers in internal RAM"
            default y
            help
                Moves Display DMA buffers to internal 64KB pool instead
                of PSRAM. Critical for stability.

        config PSRAM_MALLOC_POLICY
            string "PSRAM malloc strategy"
            default "always_internal"
            options "always_internal" "prefer_external"
            help
                Strategy for PSRAM allocation. Use "always_internal" for
                DMA buffers to prevent crashes.
    endmenu

    menu "Power Management"
        config BACKLIGHT_GPIO
            int "Backlight control GPIO"
            default 6
            help
                GPIO pin for backlight PWM control.

        config LV_SLEEP_TIMEOUT_MS
            int "Display sleep timeout (ms)"
            default 30000
            help
                Time before display enters low-power mode.
    endmenu

endmenu
```

## software/firmware/node-one/sdkconfig.defaults
```kconfig
# Node One (The Totem) - sdkconfig.defaults
# Based on xiaozhi-esp32 v1.9.0+ optimizations for ESP32-S3
# Last Updated: March 24, 2026

# ============================================
# DISPLAY CONFIGURATION (LVGL & QSPI)
# ============================================

# Color depth optimization for Waveshare 3.5B display
CONFIG_LV_COLOR_16_SWAP=y
CONFIG_LV_COLOR_DEPTH=16

# QSPI Display Driver optimizations
CONFIG_SPIRAM_MODE=OCTAL
CONFIG_SPIRAM_FREQ=80M
CONFIG_SPIRAM_SIZE=8388608

# DMA alignment for QSPI bus - prevents tearing/static issues
CONFIG_ESP32S3_DATA_CACHE_LINE_64B=y
CONFIG_DMA_ATTR_ENABLE=y
CONFIG_SPIRAM_DMA_CHUNK_SIZE=4096

# Frame rate optimization - stable 40MHz with fallback
CONFIG_LV_DISPLAY_SPI_CLOCK=40000000
CONFIG_LV_DISPLAY_SPI_MODE=QPI
CONFIG_LV_DISPLAY_RGB_SWAP_RGB888_SWAP=y

# ============================================
# TOUCH CONTROLLER (AXS15231B)
# ============================================

# Touch driver configuration
CONFIG_TOUCH_AXS15231B_ENABLED=y
CONFIG_TOUCH_SWAP_X_Y=y
CONFIG_TOUCH_INVERT_X=y
CONFIG_TOUCH_INVERT_Y=y

# Gesture recognition - prevent accidental emergency overrides
CONFIG_TOUCH_GESTURE_SWIPE_THRESHOLD=20
CONFIG_TOUCH_GESTURE_LONG_PRESS_MS=500

# ============================================
# AUDIO SUBSYSTEM (ES8311 & I2S)
# ============================================

# ES8311 MCLK-less operation - frees GPIO 44
# Prevents hardware conflict with UART console (boot loop fix)
CONFIG_ES8311_MCLK_LESS=y
CONFIG_ES8311_I2S_MODE=I2S_SLAVE
CONFIG_ES8311_MCLK_GPIO=-1

# Audio buffer sizing - prevents "pop" sound cutoff
# Increased DMA buffers for amplifier wake-up time
CONFIG_I2S_DMA_BUFFER_SIZE=512
CONFIG_I2S_DMA_BUFFER_COUNT=8
CONFIG_I2S_AEC_ENABLED=y
CONFIG_I2S_SAMPLE_RATE=48000
CONFIG_I2S_BITS_PER_SAMPLE=16

# Microphone configuration (GPIO 40)
CONFIG_I2S_MIC_ENABLED=y
CONFIG_I2S_MIC_GPIO=40
CONFIG_I2S_MIC_GAIN_DB=20

# Speaker configuration
CONFIG_I2S_SPEAKER_ENABLED=y
CONFIG_I2S_SPEAKER_GPIO=46
CONFIG_I2S_SPEAKER_VOLUME=70

# ============================================
# PSRAM OPTIMIZATION (8MB Octal)
# ============================================

# Move non-time-critical UI assets to PSRAM
# Keep Display DMA buffers in Internal RAM (64KB pool)
CONFIG_SPIRAM_ALLOW_STACK_EXEC=y
CONFIG_SPIRAM_ALLOW_NOINIT_SRAM=y
CONFIG_SPIRAM_MALLOC_ALWAYS_INTERNAL=y
CONFIG_SPIRAM_USE_MALLOC=y

# Prevent StoreProhibited crashes
CONFIG_ESP_SYSTEM_ALLOW_RTC_FAST_MEM_ALWAYS=y
CONFIG_ESP_SYSTEM_USE_EH_FRAME=y

# ============================================
# POWER MANAGEMENT
# ============================================

# Backlight control (GPIO 6)
CONFIG_LV_BACKLIGHT_GPIO=6
CONFIG_LV_BACKLIGHT_PWM_FREQ=5000
CONFIG_LV_BACKLIGHT_OFF_LEVEL=0
CONFIG_LV_BACKLIGHT_ON_LEVEL=255

# Sleep/wake transitions
CONFIG_LV_DEEP_SLEEP_ENABLED=y
CONFIG_LV_SLEEP_TIMEOUT_MS=30000

# ============================================
# MEMORY MANAGEMENT
# ============================================

# Watchdog timeout increase for QSPI stability
CONFIG_ESP_TASK_WDT_TIMEOUT_S=30
CONFIG_ESP_TASK_WDT_CHECK_IDLE_TASK_CPU0=y
CONFIG_ESP_TASK_WDT_CHECK_IDLE_TASK_CPU1=y

# Internal RAM allocation for DMA
CONFIG_ESP32S3_INSTRUCTION_CACHE_64KB=y
CONFIG_ESP32S3_INSTRUCTION_CACHE_LINE_SIZE=64
CONFIG_ESP32S3_DATA_CACHE_64KB=y
CONFIG_ESP32S3_DATA_CACHE_LINE_SIZE=64

# ============================================
# OTA & UPDATES
# ============================================

# OTA A/B partition scheme
CONFIG_ESP_BOOTLOADER_APP_ROLLBACK_ENABLE=y
CONFIG_ESP_APP_ANTI_ROLLBACK=y
CONFIG_ESP_UPDATE_AB_MODE=y

# ============================================
# DEBUGGING (Optional - disable for production)
# ============================================

# CONFIG_ESP_DEBUG_OCDAWARE=y
# CONFIG_ESP_SYSTEM_CHECK_INT_LEVEL=3
```
